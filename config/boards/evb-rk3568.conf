## external/custom/configs/rk3568_custom_defconfig
```kconfig
# Architecture
BR2_aarch64=y
BR2_cortex_a55=y

# Build options
BR2_CCACHE=y

# Toolchain
BR2_TOOLCHAIN_BUILDROOT_GLIBC=y
BR2_PACKAGE_HOST_LINUX_HEADERS_CUSTOM_6_1=y
BR2_TOOLCHAIN_BUILDROOT_CXX=y

# System
BR2_TARGET_GENERIC_HOSTNAME="rk3568-jvl"
BR2_TARGET_GENERIC_ISSUE="JVL RK3568 Platform"
BR2_ROOTFS_DEVICE_CREATION_DYNAMIC_EUDEV=y
BR2_TARGET_GENERIC_ROOT_PASSWD="root"
BR2_SYSTEM_DHCP="eth0"

# Init system
BR2_INIT_SYSTEMD=y

# Kernel - Rockchip 6.1 BSP LTS
BR2_LINUX_KERNEL=y
BR2_LINUX_KERNEL_CUSTOM_GIT=y
BR2_LINUX_KERNEL_CUSTOM_REPO_URL="https://github.com/rockchip-linux/kernel.git"
BR2_LINUX_KERNEL_CUSTOM_REPO_VERSION="develop-6.1"
BR2_LINUX_KERNEL_DEFCONFIG="rockchip_linux"
BR2_LINUX_KERNEL_DTS_SUPPORT=y
BR2_LINUX_KERNEL_CUSTOM_DTS_PATH="../external/custom/board/rk3568/dts/rk3568-dc-a568.dts"

# Rootfs overlay
BR2_ROOTFS_OVERLAY="../external/custom/board/rk3568/rootfs-overlay"

# Filesystem
BR2_TARGET_ROOTFS_EXT2=y
BR2_TARGET_ROOTFS_EXT2_4=y
BR2_TARGET_ROOTFS_EXT2_SIZE="512M"
BR2_TARGET_ROOTFS_TAR_GZIP=y

# Bootloaders - U-Boot
BR2_TARGET_UBOOT=y
BR2_TARGET_UBOOT_BUILD_SYSTEM_KCONFIG=y
BR2_TARGET_UBOOT_LATEST_VERSION=y
BR2_TARGET_UBOOT_BOARD_DEFCONFIG="evb-rk3568"
BR2_TARGET_UBOOT_CONFIG_FRAGMENT_FILES="../external/custom/board/rk3568/uboot.config"
BR2_TARGET_UBOOT_NEEDS_DTC=y
BR2_TARGET_UBOOT_NEEDS_PYLIBFDT=y
BR2_TARGET_UBOOT_NEEDS_PYELFTOOLS=y
BR2_TARGET_UBOOT_NEEDS_OPENSSL=y
BR2_TARGET_UBOOT_FORMAT_BIN=y
BR2_TARGET_UBOOT_SPL=y
BR2_TARGET_UBOOT_SPL_NAME="spl/u-boot-spl.bin"

# U-Boot vendor blobs (from rkbin)
BR2_TARGET_UBOOT_CUSTOM_MAKEOPTS="ROCKCHIP_TPL=$(TOPDIR)/../rkbin/bin/rk35/rk3568_ddr_1560MHz_v1.23.bin BL31=$(TOPDIR)/../rkbin/bin/rk35/rk3568_bl31_v1.45.elf"

# Packages - Networking
BR2_PACKAGE_DHCPCD=y
BR2_PACKAGE_DROPBEAR=y
BR2_PACKAGE_ETHTOOL=y
BR2_PACKAGE_IPROUTE2=y

# Packages - Hardware
BR2_PACKAGE_I2C_TOOLS=y
BR2_PACKAGE_PCIUTILS=y
BR2_PACKAGE_USBUTILS=y

# Packages - System
BR2_PACKAGE_UTIL_LINUX=y
BR2_PACKAGE_UTIL_LINUX_BINARIES=y

# Packages - Filesystem
BR2_PACKAGE_E2FSPROGS=y
BR2_PACKAGE_DOSFSTOOLS=y

# Host packages
BR2_PACKAGE_HOST_DOSFSTOOLS=y
BR2_PACKAGE_HOST_GENIMAGE=y
BR2_PACKAGE_HOST_MTOOLS=y
BR2_PACKAGE_HOST_PYTHON_PYELFTOOLS=y
```

## external/custom/configs/rk3568_sz3568_defconfig
```kconfig
# Architecture
BR2_aarch64=y
BR2_cortex_a55=y

# Build options
BR2_CCACHE=y

# Toolchain
BR2_TOOLCHAIN_BUILDROOT_GLIBC=y
BR2_PACKAGE_HOST_LINUX_HEADERS_CUSTOM_6_1=y
BR2_TOOLCHAIN_BUILDROOT_CXX=y

# System
BR2_TARGET_GENERIC_HOSTNAME="sz3568-v10"
BR2_TARGET_GENERIC_ISSUE="Rockchip RK3568 SZ3568 V10 Board"
BR2_ROOTFS_DEVICE_CREATION_DYNAMIC_EUDEV=y
BR2_TARGET_GENERIC_ROOT_PASSWD="root"
BR2_SYSTEM_DHCP="eth0"

# Init system
BR2_INIT_SYSTEMD=y

# Kernel - Rockchip 6.1 BSP LTS
BR2_LINUX_KERNEL=y
BR2_LINUX_KERNEL_CUSTOM_GIT=y
BR2_LINUX_KERNEL_CUSTOM_REPO_URL="https://github.com/rockchip-linux/kernel.git"
BR2_LINUX_KERNEL_CUSTOM_REPO_VERSION="develop-6.1"
BR2_LINUX_KERNEL_DEFCONFIG="rockchip_linux"
BR2_LINUX_KERNEL_DTS_SUPPORT=y
BR2_LINUX_KERNEL_CUSTOM_DTS_PATH="../external/custom/board/rk3568/dts/rockchip/rk3568-sz3568.dts"
BR2_LINUX_KERNEL_CONFIG_FRAGMENT_FILES="../external/custom/board/rk3568/kernel.config"
BR2_LINUX_KERNEL_PATCH="../external/custom/patches/linux"

# Rootfs overlay
BR2_ROOTFS_OVERLAY="../external/custom/board/rk3568/rootfs-overlay"

# Filesystem
BR2_TARGET_ROOTFS_EXT2=y
BR2_TARGET_ROOTFS_EXT2_4=y
BR2_TARGET_ROOTFS_EXT2_SIZE="512M"
BR2_TARGET_ROOTFS_TAR_GZIP=y

# Bootloaders - U-Boot
BR2_TARGET_UBOOT=y
BR2_TARGET_UBOOT_BUILD_SYSTEM_KCONFIG=y
BR2_TARGET_UBOOT_LATEST_VERSION=y
BR2_TARGET_UBOOT_BOARD_DEFCONFIG="evb-rk3568"
BR2_TARGET_UBOOT_CONFIG_FRAGMENT_FILES="../external/custom/board/rk3568/uboot.config"
BR2_TARGET_UBOOT_NEEDS_DTC=y
BR2_TARGET_UBOOT_NEEDS_PYLIBFDT=y
BR2_TARGET_UBOOT_NEEDS_PYELFTOOLS=y
BR2_TARGET_UBOOT_NEEDS_OPENSSL=y
BR2_TARGET_UBOOT_FORMAT_BIN=y
BR2_TARGET_UBOOT_SPL=y
BR2_TARGET_UBOOT_SPL_NAME="spl/u-boot-spl.bin"

# U-Boot vendor blobs (from rkbin)
BR2_TARGET_UBOOT_CUSTOM_MAKEOPTS="ROCKCHIP_TPL=$(TOPDIR)/../rkbin/bin/rk35/rk3568_ddr_1560MHz_v1.23.bin BL31=$(TOPDIR)/../rkbin/bin/rk35/rk3568_bl31_v1.45.elf"

# Packages - Networking
BR2_PACKAGE_DHCPCD=y
BR2_PACKAGE_DROPBEAR=y
BR2_PACKAGE_ETHTOOL=y
BR2_PACKAGE_IPROUTE2=y

# Packages - WiFi
BR2_PACKAGE_RTL8723DS=y
BR2_PACKAGE_WPA_SUPPLICANT=y
BR2_PACKAGE_WPA_SUPPLICANT_NL80211=y
BR2_PACKAGE_WPA_SUPPLICANT_PASSPHRASE=y
BR2_PACKAGE_WIRELESS_TOOLS=y
BR2_PACKAGE_IW=y

# Packages - Hardware
BR2_PACKAGE_I2C_TOOLS=y
BR2_PACKAGE_PCIUTILS=y
BR2_PACKAGE_USBUTILS=y

# Packages - Display/Graphics
BR2_PACKAGE_LIBDRM=y
BR2_PACKAGE_LIBDRM_INSTALL_TESTS=y
BR2_PACKAGE_MESA3D=y
BR2_PACKAGE_MESA3D_GALLIUM_DRIVER_PANFROST=y
BR2_PACKAGE_MESA3D_OPENGL_EGL=y
BR2_PACKAGE_MESA3D_OPENGL_ES=y

# Packages - Audio
BR2_PACKAGE_ALSA_UTILS=y
BR2_PACKAGE_ALSA_UTILS_ALSACTL=y
BR2_PACKAGE_ALSA_UTILS_APLAY=y
BR2_PACKAGE_ALSA_UTILS_AMIXER=y
BR2_PACKAGE_ALSA_UTILS_SPEAKER_TEST=y

# Packages - System (GNU tools instead of busybox)
BR2_PACKAGE_BUSYBOX=n
BR2_PACKAGE_BASH=y
BR2_SYSTEM_DEFAULT_SHELL_BASH=y
BR2_PACKAGE_COREUTILS=y
BR2_PACKAGE_DIFFUTILS=y
BR2_PACKAGE_FINDUTILS=y
BR2_PACKAGE_GAWK=y
BR2_PACKAGE_GREP=y
BR2_PACKAGE_GZIP=y
BR2_PACKAGE_LESS=y
BR2_PACKAGE_PROCPS_NG=y
BR2_PACKAGE_PSMISC=y
BR2_PACKAGE_SED=y
BR2_PACKAGE_TAR=y
BR2_PACKAGE_UTIL_LINUX=y
BR2_PACKAGE_UTIL_LINUX_BINARIES=y
BR2_PACKAGE_VIM=y
BR2_PACKAGE_WHICH=y

# Packages - Filesystem
BR2_PACKAGE_E2FSPROGS=y
BR2_PACKAGE_DOSFSTOOLS=y

# Host packages
BR2_PACKAGE_HOST_DOSFSTOOLS=y
BR2_PACKAGE_HOST_GENIMAGE=y
BR2_PACKAGE_HOST_MTOOLS=y
BR2_PACKAGE_HOST_PYTHON_PYELFTOOLS=y
```

## external/jvl/Config.in
```kconfig
# JVL RK3568 External Configuration

source "$BR2_EXTERNAL_JVL_PATH/package/Config.in"
```

## external/jvl/configs/rk3568_jvl_defconfig
```kconfig
# Architecture
BR2_aarch64=y
BR2_cortex_a55=y

# Build options
BR2_CCACHE=y

# Toolchain
BR2_TOOLCHAIN_BUILDROOT_GLIBC=y
BR2_PACKAGE_HOST_LINUX_HEADERS_CUSTOM_6_6=y
BR2_TOOLCHAIN_BUILDROOT_CXX=y

# System
BR2_TARGET_GENERIC_HOSTNAME="rk3568-jvl"
BR2_TARGET_GENERIC_ISSUE="JVL RK3568 Platform"
BR2_ROOTFS_DEVICE_CREATION_DYNAMIC_EUDEV=y
BR2_TARGET_GENERIC_ROOT_PASSWD="root"
BR2_SYSTEM_DHCP="eth0"

# Init system
BR2_INIT_SYSTEMD=y

# Kernel
BR2_LINUX_KERNEL=y
BR2_LINUX_KERNEL_CUSTOM_VERSION=y
BR2_LINUX_KERNEL_CUSTOM_VERSION_VALUE="6.6.62"
BR2_LINUX_KERNEL_USE_DEFCONFIG=y
BR2_LINUX_KERNEL_DEFCONFIG="defconfig"
BR2_LINUX_KERNEL_DTS_SUPPORT=y
BR2_LINUX_KERNEL_INTREE_DTS_NAME="rockchip/rk3568-evb1-ddr4-v10"

# Filesystem
BR2_TARGET_ROOTFS_EXT2=y
BR2_TARGET_ROOTFS_EXT2_4=y
BR2_TARGET_ROOTFS_TAR_GZIP=y

# Bootloaders
# U-Boot disabled for now - will be added with vendor BSP in Feature 6
# BR2_TARGET_UBOOT is not set

# Packages - Networking
BR2_PACKAGE_DHCPCD=y
BR2_PACKAGE_DROPBEAR=y
BR2_PACKAGE_ETHTOOL=y
BR2_PACKAGE_IPROUTE2=y

# Packages - Hardware
BR2_PACKAGE_I2C_TOOLS=y
BR2_PACKAGE_PCIUTILS=y
BR2_PACKAGE_USBUTILS=y

# Packages - System
BR2_PACKAGE_UTIL_LINUX=y
BR2_PACKAGE_UTIL_LINUX_BINARIES=y

# Packages - Filesystem
BR2_PACKAGE_E2FSPROGS=y
BR2_PACKAGE_DOSFSTOOLS=y

# Host packages
BR2_PACKAGE_HOST_DOSFSTOOLS=y
BR2_PACKAGE_HOST_GENIMAGE=y
BR2_PACKAGE_HOST_MTOOLS=y
```
